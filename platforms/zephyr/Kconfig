## platforms/zephyr/Kconfig
```kconfig
source "$ZEPHYR_BASE/Kconfig.zephyr"

config RANDOM_EID
    bool "Randomly generate a EID by replacing all occurences of * in the EID"
    default n

config EID
	string "Default EID use RANDOM_EID to replace occurences of * with random hex values"
	default "dtn://ud3tn.dtn"

config CONTACT_TIMEOUT_S
	int "Contact Timeout in seconds, too old contacts will thus be removed"
	default 60


config BUNDLE_PROCESSOR_AUTO_REMOVE_EXPIRED_KNOWN_BUNDLES
    bool "Automatically delete expired bundles (i.e. deadline in the past)"
	default n


config FAKE_BUNDLE_INTERVAL
    int "The interval to generate fake bundles (in seconds). 0 for no generation"
	default 0

config FAKE_BUNDLE_SIZE_MIN
    int "The minimum size of a fake bundle (in bytes)"
	default 1024

config FAKE_BUNDLE_SIZE_MAX
    int "The maximum size of a fake bundle (in bytes)"
	default 1024

config FAKE_BUNDLE_LIFETIME
    int "The interval to generate fake bundles (in seconds). 0 for no generation"
	default 0
```

## zephyr/Kconfig
```kconfig
source "$ZEPHYR_BASE/Kconfig.zephyr"

config RANDOM_EID
    bool "Randomly generate a EID by replacing all occurences of * in the EID"
    default n

config EID
	string "Default EID use RANDOM_EID to replace occurences of * with random hex values"
	default "dtn://ud3tn.dtn"

config CONTACT_TIMEOUT_S
	int "Contact Timeout in seconds, too old contacts will thus be removed"
	default 60


config BUNDLE_PROCESSOR_AUTO_REMOVE_EXPIRED_KNOWN_BUNDLES
    bool "Automatically delete expired bundles (i.e. deadline in the past)"
	default n


config FAKE_BUNDLE_INTERVAL
    int "The interval to generate fake bundles (in seconds). 0 for no generation"
	default 0

config FAKE_BUNDLE_MULTIPLIER
    int "The number of fake bundles to generate at each interval"
	default 1

config FAKE_BUNDLE_SIZE_MIN
    int "The minimum size of a fake bundle (in bytes)"
	default 1024

config FAKE_BUNDLE_SIZE_MAX
    int "The maximum size of a fake bundle (in bytes)"
	default 1024

config FAKE_BUNDLE_LIFETIME
    int "The interval to generate fake bundles (in seconds)."
	default 5

config DIRECT_TRANSMISSION_REPLICAS
    int "The amount of replicas on top of the direct transmission"
	default 0


config HEAP_SIZE
    int "The available Heap size for malloc functionality. Disabled for native applications."
    depends on !NATIVE_APPLICATION
	default 16384


config NB_BLE_MIN_RSSI
    int "The minimum rssi required to report neighbors (and thus initialize a connection)"
    range -120 20
	default -120

config NB_SV_FILTER_SIZE
    int "The amount of filtered summary vector characteristics"
    range 0 1024
    default 0
```
